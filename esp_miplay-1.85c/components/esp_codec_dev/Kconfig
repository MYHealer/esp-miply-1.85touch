## esp_miplay-1.85c/components/esp_codec_dev/Kconfig
```kconfig
menu "Audio Codec Device Configuration"
    config CODEC_ES8311_SUPPORT
        bool "Support ES8311 Codec Chip"
        default y
endmenu
```
